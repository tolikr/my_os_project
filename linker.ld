ENTRY(_start)
SECTIONS {
    /* Базовый адрес загрузки (убедитесь, что он соответствует карте памяти вашей платы/QEMU) */
    . = 0x80200000;

    .text.init : {
        *(.text.entry)
    }

    .text : {
        *(.text .text.*)
    }

    /* Секция для инициализированных данных */
    .data : {
        *(.data .data.*)
        
        /* Специфичные для RISC-V секции «мелких» данных */
        *(.sdata .sdata.*)
    }

    /* Секция для неинициализированных данных */
    .bss : {
        *(.bss .bss.* COMMON)
        
        /* Специфичные для RISC-V секции «мелких» неинициализированных данных */
        *(.sbss .sbss.*)
    }

    /* Выравнивание стека по границе 16 байт (жесткое требование RISC-V ABI) */
    . = ALIGN(16);
    . += 0x1000;          /* Выделяем 4 КБ под стек */
    stack_top = .;
}